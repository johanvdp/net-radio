## components/mem/Kconfig
```kconfig
# The author disclaims copyright to this source code.
menu "SPI_RAM"

config SPI_RAM_GPIO_CS
    int "SPI RAM GPIO pin for CS (0-39)"
    default 5
    range 0 39
    help
        SPI RAM GPIO pin for CS output (0-39).

config SPI_RAM_SPEED_MHZ
    int "SPI RAM clock frequency (1-50) MHz"
    default 20
    range 1 40
    help
        SPI RAM clock frequency (1-50) MHz.

config SPI_RAM_TOTAL_BYTES
    int "SPI RAM total bytes (1-1048576)"
    default 131072
    range 1 1048576
    help
        SPI RAM total bytes (1-1048576).

config SPI_RAM_NUMBER_OF_PAGES
    int "SPI RAM number of pages (1-1048576)"
    default 4092
    range 1 1048576
    help
        SPI RAM number of pages (1-1048576).

config SPI_RAM_BYTES_PER_PAGE
    int "SPI RAM bytes per page (1-1048576)"
    default 32
    range 1 1048576
    help
        SPI RAM bytes per page (1-1048576).

endmenu
```

## main/Kconfig.projbuild
```kconfig
# The author disclaims copyright to this source code.
# 
# For language definition see:
# https://www.mjmwired.net/kernel/Documentation/kbuild/kconfig-language.txt
#
menu "Application Configuration"

# HSPI bus

config GPIO_HSPI_CLK
    int "GPIO pin for HSPI CLK (0-39)"
    default 14
    range 0 39
    help
        Select the GPIO pin for HSPI CLK (0-39).

config GPIO_HSPI_MOSI
    int "GPIO pin for HSPI MOSI (0-39)"
    default 13
    range 0 39
    help
        Select the GPIO pin for HSPI MOSI (0-39).

config GPIO_HSPI_MISO
    int "GPIO pin for HSPI MISO (0-39)"
    default 12
    range 0 39
    help
        Select the GPIO pin for HSPI MISO (0-39).

# VSPI bus

config GPIO_VSPI_CLK
    int "GPIO pin for VSPI CLK (0-39)"
    default 18
    range 0 39
    help
        Select the GPIO pin for VSPI CLK (0-39).

config GPIO_VSPI_MOSI
    int "GPIO pin for VSPI MOSI (0-39)"
    default 23
    range 0 39
    help
        Select the GPIO pin for VSPI MOSI (0-39).

config GPIO_VSPI_MISO
    int "GPIO pin for VSPI MISO (0-39)"
    default 19
    range 0 39
    help
        Select the GPIO pin for VSPI MISO (0-39).

# Control


# I2C bus

config GPIO_I2C_SDA
    int "GPIO pin for I2C SDA (0-39)"
    default 16
    range 0 39
    help
        Select the GPIO pin for I2C SDA (0-39).

config GPIO_I2C_SCL
    int "GPIO pin for I2C SCL (0-39)"
    default 17
    range 0 39
    help
        Select the GPIO pin for I2C SCL (0-39).

menu "BLINK"

config BLINK_GPIO
    int "BLINK GPIO pin for LED (0-39)"
    default 2
    range 0 39
    help
        BLINK GPIO pin for LED output (0-39).

config BLINK_ON_MS
    int "BLINK LED ON duration (10-1000) ms"
    default 50
    range 10 1000
    help
        BLINK LED ON duration (10-1000) in ms.

config BLINK_OFF_MS
    int "BLINK LED OFF duration (10-2000) ms"
    default 1950
    range 10 2000
    help
        BLINK LED OFF duration (10-2000) in ms.

endmenu

menu "DSP"

config DSP_GPIO_RST
    int "DSP GPIO pin for RST (0-39)"
    default 26
    range 0 39
    help
        DSP GPIO pin for RST output (0-39).

config DSP_GPIO_DREQ
    int "DSP GPIO pin for DREQ (0-39)"
    default 27
    range 0 39
    help
        DSP GPIO pin for DREQ input (0-39).

config DSP_GPIO_XDCS
    int "DSP GPIO pin for Data CS (0-39)"
    default 15
    range 0 39
    help
        DSP GPIO pin for Data CS output (0-39).

config DSP_GPIO_XCS
    int "DSP GPIO pin for Control CS (0-39)"
    default 4
    range 0 39
    help
        DSP GPIO pin for Control CS output (0-39).

config DSP_SPI_SPEED_START_KHZ
    int "DSP SPI clock frequency startup (100-1000) kHz"
    default 200
    range 100 1000
    help
        DSP SPI clock frequency startup (100-1000) kHz.

config DSP_SPI_SPEED_KHZ
    int "DSP SPI clock frequency (100-20000) kHz"
    default 4000
    range 100 20000
    help
        DSP SPI clock frequency (100-20000) kHz.

endmenu

menu "SPI_MEM"

config MEM_GPIO_CS
    int "SPI RAM GPIO pin for CS (0-39)"
    default 5
    range 0 39
    help
        SPI RAM GPIO pin for CS output (0-39).

config MEM_SPEED_MHZ
    int "SPI RAM clock frequency (1-50) MHz"
    default 20
    range 1 40
    help
        SPI RAM clock frequency (1-50) MHz.

config MEM_TOTAL_BYTES
    int "SPI RAM total bytes (1-1048576)"
    default 131072
    range 1 1048576
    help
        SPI RAM total bytes (1-1048576).

config MEM_NUMBER_OF_PAGES
    int "SPI RAM number of pages (1-1048576)"
    default 4092
    range 1 1048576
    help
        SPI RAM number of pages (1-1048576).

config MEM_BYTES_PER_PAGE
    int "SPI RAM bytes per page (1-1048576)"
    default 32
    range 1 1048576
    help
        SPI RAM bytes per page (1-1048576).

endmenu

endmenu
```
